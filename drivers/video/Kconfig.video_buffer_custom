## drivers/video/Kconfig.video_buffer_custom
```kconfig
config VIDEO_CUSTOM_SECTION
    bool "custom video mem pool section"
    default n

config VIDEO_CUSTOM_SECTION_NAME
    string "custom video mem pool section name"
    default ""
```

## samples/subsys/input/input_dump/boards/csk6012_nano.conf
```kconfig
CONFIG_INPUT_THREAD_STACK_SIZE=4096

CONFIG_ADC=y
CONFIG_ADC_CSK6=y
CONFIG_ADC_CSK6_OUTPUT_FIXUP=y
```

## samples/subsys/input/input_dump/boards/csk6_duomotai_devkit.conf
```kconfig
CONFIG_INPUT_FT5336=n
CONFIG_INPUT_THREAD_STACK_SIZE=4096

CONFIG_GPIO=y
CONFIG_GPIO_CSK6=y

CONFIG_ADC=y
CONFIG_ADC_CSK6_CH32V003=y
```

## subsys/usb/device/class/audio/Kconfig
```kconfig
# USB AUDIO configuration options

# Copyright (c) 2020 Nordic Semiconductor ASA
# SPDX-License-Identifier: Apache-2.0

config USB_DEVICE_AUDIO
	bool "USB Audio Device Class Driver"
	help
	  USB Audio Device Class driver.
	  Zephyr USB Audio Class is considered experimental
	  and not full.
	  Device configuration is done via dt overlay.

if USB_DEVICE_AUDIO

module = USB_AUDIO
module-str = USB Audio
source "subsys/logging/Kconfig.template.log_config"


config USB_DEVICE_AUDIO_MIN_VOLUME
	hex "USB Audio Device Min Volume"
	default 0
	range 0 0x8000
	help 
	  attributes can range from +127.9961 dB (0x7FFF) down to -127.9961 dB (0x8001)

config USB_DEVICE_AUDIO_MAX_VOLUME
	hex "USB Audio Device Max Volume"
	default 0x7FFF
	range 0 0x8000
	help 
	  attributes can range from +127.9961 dB (0x7FFF) down to -127.9961 dB (0x8001)

config USB_DEVICE_AUDIO_RES_VOLUME
	hex "USB Audio Device Max Volume"
	default 0x1
	range 0x1 0x7FFF
	help
	  The settings for the RES attribute can only take positive values and range from 1/256
	  dB (0x0001) to +127.9961 dB (0x7FFF).

endif #USB_DEVICE_AUDIO
```

## tests/drivers/dma/chan_blen_transfer/boards/csk6011a_nano.conf
```kconfig
CONFIG_DMA_TRANSFER_CHANNEL_NR_0=0
CONFIG_DMA_TRANSFER_CHANNEL_NR_1=5
CONFIG_HEAP_MEM_POOL_SIZE=16384
CONFIG_NOCACHE_MEMORY=y
```

## tests/drivers/dma/loop_transfer/boards/csk6012_nano.conf
```kconfig
CONFIG_DMA_LOOP_TRANSFER_CHANNEL_NR=4
CONFIG_HEAP_MEM_POOL_SIZE=16384
CONFIG_NOCACHE_MEMORY=y
```

## tests/drivers/gpio/gpio_api_1pin/boards/csk6_duomotai_devkit.conf
```kconfig
CONFIG_ZTEST=y
CONFIG_TEST_USERSPACE=y
CONFIG_GPIO=y
CONFIG_GPIO_CSK6_CH32V003=y
```

## tests/drivers/spi/spi_loopback/boards/csk6011a_nano.conf
```kconfig
#
# SPDX-License-Identifier: Apache-2.0
#

CONFIG_HEAP_MEM_POOL_SIZE=10240
CONFIG_CSK6_DCACHE=n
```

## tests/drivers/uart/uart_async_api/boards/csk6_duomotai_devkit.conf
```kconfig
CONFIG_UART_ASYNC_API=y
CONFIG_LOG=y
CONFIG_DMA=y
CONFIG_DMA_CSK6=y
CONFIG_CSK6_DCACHE=n
```
